## apps/examples/smart_light/Kconfig
```kconfig
config EXAMPLES_SMART_LIGHT
	bool "Smart Light example"
	depends on ARTIK_SDK
	select NETUTILS_MDNS
	select NETUTILS_MDNS_RESPONDER_SUPPORT
	select NETUTILS_JSON
	select NETUTILS_NTPCLIENT
	select NETDB_DNSCLIENT
	select EXAMPLES_NTPCLIENT_TEST
	default y
	---help---
		Install the smart light example, which
		allows onboarding the device to Wi-Fi hotspot
		then to ARTIK Cloud as well as remotly controlling
		the light connected on ARTIK board.

config USER_ENTRYPOINT
	string
	default "smart_light_main" if ENTRY_SMART_LIGHT
```
